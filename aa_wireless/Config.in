## aa_wireless/package/Config.in
```kconfig
menu "Packages"
    source "$BR2_EXTERNAL_AA_WIRELESS_PATH/package/aawg/Config.in"
    source "$BR2_EXTERNAL_AA_WIRELESS_PATH/package/dbus-cxx-custom/Config.in"
endmenu
```
